/*

  This example creates a BLE peripheral with service that contains a
  characteristic to send example ECG data.

  For Arudino Nano 33 BLE Sense

*/

#include <ArduinoBLE.h>

BLEService ecgService("A22A3B82-63C4-4720-BF3A-6F5EF8CA42D4"); // BLE LED Service

// BLE LED Switch Characteristic - custom 128-bit UUID, read and writable by central
BLEByteCharacteristic ecgVal("A22A3B82-63C4-4720-BF3A-6F5EF8CA42D4", BLERead | BLEWrite);
//BLEByteCharacteristic timeVal(

const int ledPin = LED_BUILTIN; // pin to use for the LED

const int maxLen = 250;
int count = 0;

double times[] = {0.0000,0.0080,0.0160,0.0240,0.0320,0.0400,0.0480,0.0560,0.0640,0.0720, \
0.0800,0.0880,0.0960,0.1040,0.1120,0.1200,0.1280,0.1360,0.1440,0.1520,0.1600,0.1680,0.1760, \
0.1840,0.1920,0.2000,0.2080,0.2160,0.2240,0.2320,0.2400,0.2480,0.2560,0.2640,0.2720,0.2800, \
0.2880,0.2960,0.3040,0.3120,0.3200,0.3280,0.3360,0.3440,0.3520,0.3600,0.3680,0.3760,0.3840, \
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1.9520,1.9600,1.9680,1.9760,1.9840,1.9920};

double ecgs[] = {0.0000,0.0000,0.0000,0.0000,0.0050,0.0100,0.0100,0.0250,0.0250,0.0250,0.0250, \
0.0300,0.0300,0.0360,0.0360,0.0360,0.0360,0.0360,0.0420,0.0840,0.2200,0.3560,0.4920,0.6280, \
0.7640,0.9000,1.0720,1.3440,1.6160,1.8880,2.0000,2.0000,2.0000,2.0000,1.7520,1.4800,1.2080, \
0.9360,0.6640,0.3920,0.1200,0.0000,0.0000,0.0000,0.0000,0.0000,0.0000,0.0000,0.0560,0.3280, \
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0.0100,0.0100,0.0100,0.0100,0.0100,0.0100,0.0000,0.0000,0.0000,0.0000,0.0000};

void setup() {
  Serial.begin(9600);
  while (!Serial);

  // set LED pin to output mode
  pinMode(ledPin, OUTPUT);

  // begin initialization
  if (!BLE.begin()) {
    Serial.println("starting BLE failed!");

    while (1);
  }

  // set advertised local name and service UUID:
  BLE.setLocalName("ECG");
  BLE.setAdvertisedService(ecgService);


  // add the characteristic to the service
  ecgService.addCharacteristic(ecgVal);
  // add service
  BLE.addService(ecgService);

  ecgVal.writeValue(0);
  //ecgService.addCharacteristic(timeVal);

  // start advertising
  BLE.advertise();

  Serial.println("BLE ECG Peripheral");
}

void loop() {
  // listen for BLE peripherals to connect:
  BLEDevice central = BLE.central();

  // if a central is connected to peripheral:
  if (central) {
    Serial.print("Connected to central: ");
    // print the central's MAC address:
    Serial.println(central.address());

    // while the central is still connected to peripheral:
    while (central.connected()) {

      // timeVal.writeValue(times[count]);
      /*if (ecgVal.writeValue(ecgs[count])) {
        Serial.println(ecgs[count]);
        Serial.println('\n'); 
      }*/

      if (ecgVal.written()) {
        if (ecgVal.value()) {   // any value other than 0
          Serial.println("LED on");
          Serial.println(count);
          digitalWrite(ledPin, HIGH);         // will turn the LED on
          count++;
          if (count == maxLen) { count = 0; } // reset count if it exceeds max array length
        } else {                              // a 0 value
          Serial.println(F("LED off"));
          digitalWrite(ledPin, LOW);          // will turn the LED off
        }
        
      } 
    }
    // when the central disconnects, print it out:
    Serial.print(F("Disconnected from central: "));
    Serial.println(central.address());

  }
}
